## lib/Kconfig.kftf
```kconfig
# SPDX-License-Identifier: GPL-2.0-only

config KFTF
	tristate "Enable Kernel Fuzz Testing Framework (KFTF)"
    depends on DEBUG_FS
```

## lib/Kconfig.kfuzztest
```kconfig
# SPDX-License-Identifier: GPL-2.0-only

config KFUZZTEST
	bool "KFuzzTest - enable support for internal fuzz targets"
    depends on DEBUG_FS && KASAN
    help
      Enables support for the kernel fuzz testing framework (KFuzzTest), an
      interface for exposing internal kernel functions to a userspace fuzzing
      engine. KFuzzTest targets are exposed via a debugfs interface that
      accepts serialized userspace inputs, and is designed to make it easier
      to fuzz deeply nested kernel code that is hard to reach from the system
      call boundary.
```
